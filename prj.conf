## CMakeLists.txt
```
cmake_minimum_required(VERSION 3.20.0)
find_package(Zephyr REQUIRED HINTS $ENV{ZEPHYR_BASE})

project(ov6770)

file(GLOB SRCS "./src/*")
target_sources(app PRIVATE ${SRCS} )

#file(GLOB MODULES LIST_DIRECTORIES true "./src/modules/*")
#add_subdirectory(${MODULES})
```

## prj.conf
```kconfig
CONFIG_GPIO=y
CONFIG_LOG=y
CONFIG_LOG_DEFAULT_LEVEL=3
CONFIG_LOG_BACKEND_UART=y
CONFIG_UART_CONSOLE=y
CONFIG_ASSERT=y
CONFIG_I2C=y
#CONFIG_SPI=y
#CONFIG_SPI_LOG_LEVEL_DBG=y
```

## boards/stm32_min_dev_blue.overlay
```dts
/ {

};

&i2c1 {

};
```

## src/main.c
```c
#include <zephyr/kernel.h>
#include <zephyr/drivers/gpio.h>
#include <zephyr/drivers/i2c.h>
#include <zephyr/logging/log.h>

const struct gpio_dt_spec led = GPIO_DT_SPEC_GET(DT_NODELABEL(led), gpios);

LOG_MODULE_REGISTER(main);

int main(void)
{
    gpio_pin_configure_dt(&led, GPIO_OUTPUT_ACTIVE);

    LOG_INF("boot");

    while (1)
    {
        k_msleep(200);
    }

    return 0;
}
```

## src/th_blink.c
```c
#include <zephyr/kernel.h>
#include <zephyr/drivers/gpio.h>

extern const struct gpio_dt_spec led;
void th_blink();

K_THREAD_DEFINE(th_blink_id, 512, th_blink, NULL, NULL, NULL, 5, 0, 0);

void th_blink()
{
    int i;
    while (1)
    {
        for (i = 0; i < 6; i++)
        {
            gpio_pin_toggle_dt(&led);
            k_msleep(50);
        }
        gpio_pin_set_dt(&led, 0);

        k_msleep(1000);
    }
}
```
